VERSION ""

NS_ :

BS_:

BU_: XXX

BO_ 151 Accelerometers: 8 XXX
 SG_ NEW_SIGNAL_2 : 6|24@0+ (1,0) [0|65535] "" XXX
 SG_ Accelerometer_Roll : 23|16@0+ (1,0) [0|255] "" XXX

BO_ 310 Throttle: 8 XXX
 SG_ NEW_SIGNAL_1 : 63|8@0+ (1,0) [0|255] "" XXX
 SG_ Throttle : 31|16@0+ (1,0) [0|65535] "" XXX
